## meta/conf/machine/qemux86.conf
```bitbake
#@TYPE: Machine
#@NAME: common_pc
#@DESCRIPTION: Machine configuration for running a common x86

PREFERRED_PROVIDER_virtual/xserver ?= "xserver-xorg"
PREFERRED_PROVIDER_virtual/libgl ?= "mesa"
PREFERRED_PROVIDER_virtual/libgles1 ?= "mesa"
PREFERRED_PROVIDER_virtual/libgles2 ?= "mesa"

require conf/machine/include/qemu.inc
require conf/machine/include/tune-i586.inc
require conf/machine/include/qemuboot-x86.inc

KERNEL_IMAGETYPE = "bzImage"

SERIAL_CONSOLES ?= "115200;ttyS0 115200;ttyS1"

XSERVER = "xserver-xorg \
           ${@bb.utils.contains('DISTRO_FEATURES', 'opengl', 'mesa-driver-swrast xserver-xorg-extension-glx', '', d)} \
           xf86-input-vmmouse \
           xf86-input-keyboard \
           xf86-input-evdev \
           xf86-video-cirrus \
           xf86-video-fbdev \
           xf86-video-vmware \
           xf86-video-modesetting \
           xserver-xorg-module-libint10 \
           "

MACHINE_FEATURES += "x86"

MACHINE_ESSENTIAL_EXTRA_RDEPENDS += "v86d"

WKS_FILE = "directdisk.wks"
do_image_wic[depends] += "syslinux:do_build syslinux-native:do_populate_sysroot mtools-native:do_populate_sysroot dosfstools-native:do_populate_sysroot"


#KERNEL_MODULE_AUTOLOAD += "uvesafb"
KERNEL_MODULE_PROBECONF += "uvesafb"

UVESA_MODE ?= "1920x1080-32"
module_conf_uvesafb = "options uvesafb mode_option=${UVESA_MODE}"

# Prevent vboxvideo from loading, it conflicts with uvesafb
KERNEL_MODULE_PROBECONF += "vboxvideo"
module_conf_vboxvideo = "blacklist vboxvideo"

# installing this module alongside kernel-module-uvesafb caused 2 fb
# devices being initialized and emulator QPA failing to start
BAD_RECOMMENDATIONS += "kernel-module-vboxvideo"
KERNEL_MODULE_AUTOLOAD_remove_pn-vboxguestdrivers = "vboxvideo"

PREFERRED_VERSION_mesa = "10.3.7"
```
